## configs/sun55iw3p1_t527_defconfig
```kconfig
CONFIG_SUNXI_TEXT_SIZE=0x150000
CONFIG_ARM=y
CONFIG_ARM_SMCCC=y
CONFIG_SYS_TEXT_BASE=0x4A000000
CONFIG_SUNXI_SECURE_BOOT=y
CONFIG_SUNXI_WDT_V2=y
CONFIG_MACH_SUN55IW3=y
CONFIG_R_I2C0_ENABLE=y
CONFIG_USB0_VBUS_PIN="PB12"
CONFIG_USB1_VBUS_PIN="PB3"
CONFIG_DEFAULT_DEVICE_TREE="sun55iw3p1-soc-system"
# CONFIG_SYS_MALLOC_CLEAR_ON_INIT is not set
CONFIG_PHYS_64BIT=y
CONFIG_ANDROID_BOOT_IMAGE=y
CONFIG_SUNXI_SERIAL=y
CONFIG_ANDROID_AB=y
CONFIG_SUNXI_MAC=y
CONFIG_SUNXI_GPIO_POWER_VOL_MODE=y
CONFIG_SUNXI_USER_KEY=y
CONFIG_SUNXI_DRM_SUPPORT=y
CONFIG_SUNXI_ANDROID_BOOT=y
CONFIG_SUNXI_VERIFY_BOOT_INFO_INSTALL=y
CONFIG_SUNXI_NECESSARY_REPLACE_FDT=y
CONFIG_SUNXI_HOMLET=y
CONFIG_RECOVERY_KEY=y
CONFIG_SUNXI_HDCP_IN_SECURESTORAGE=y
CONFIG_SUNXI_RKP=y
CONFIG_CMD_FASTBOOT=y
CONFIG_CMD_PART=y
CONFIG_CMD_USB=y
CONFIG_CMD_AB_SELECT=y
CONFIG_CMD_NET=y
CONFIG_CMD_MII=y
CONFIG_CMD_PING=y
CONFIG_CMD_EXT4=y
CONFIG_CMD_SUNXI_TIMER=y
CONFIG_CMD_SUNXI_CLK=y
CONFIG_CMD_SUNXI_SPRITE=y
CONFIG_CMD_SUNXI_BURN=y
CONFIG_CMD_SUNXI_MEMTEST=y
CONFIG_CMD_SUNXI_BOOTR=y
CONFIG_CMD_SUNXI_BOOTRV=y
CONFIG_CMD_SUNXI_CE_TEST=y
CONFIG_AIOT_DISP_PARAM_UPDATE=y
CONFIG_AIOT_DISP_PARAM_UPDATE_DEBUG=y
CONFIG_LAST_PARTITION_NAME="userdata"
CONFIG_NET_RANDOM_ETHADDR=y
CONFIG_DM=y
CONFIG_BLOCK_CACHE=y
CONFIG_CLK_SUNXI=y
CONFIG_SUNXI_DMA=y
CONFIG_SUNXI_GPIO_V2=y
CONFIG_SYS_I2C_SUNXI=y
CONFIG_SYS_SUNXI_R_I2C0_SPEED=400000
CONFIG_SYS_SUNXI_R_I2C0_SLAVE=0x35
CONFIG_AXP1530_SUNXI_I2C_SLAVE=0x36
CONFIG_AXP858_SUNXI_I2C_SLAVE=0x36
CONFIG_AXP81X_SUNXI_I2C_SLAVE=0x34
CONFIG_AXP806_SUNXI_I2C_SLAVE=0x36
CONFIG_AXP2202_SUNXI_I2C_SLAVE=0x35
CONFIG_MMC=y
CONFIG_SPI_SAMP_DL_EN=y
CONFIG_NETDEVICES=y
CONFIG_SUNXI_GMAC=y
CONFIG_SUNXI_POWER=y
CONFIG_SUNXI_PMU=y
CONFIG_SUNXI_BMU=y
CONFIG_SUNXI_PMU_EXT=y
CONFIG_AXP858_POWER=y
CONFIG_AXP2202_POWER=y
CONFIG_AXP1530_POWER=y
CONFIG_AXP81X_POWER=y
CONFIG_AXP806_POWER=y
CONFIG_TCS4838_POWER=y
CONFIG_SY8827G_POWER=y
CONFIG_SUNXI_UBOOT_POWER_OFF=y
CONFIG_USB=y
CONFIG_USB_EHCI_HCD=y
CONFIG_USB_STORAGE=y
CONFIG_AW_DRM=y
CONFIG_AW_DRM_LVDS=y
CONFIG_AW_DRM_RGB=y
CONFIG_AW_DRM_DSI=y
CONFIG_AW_DRM_EDP=y
CONFIG_AW_DRM_INNO_EDP13=y
# CONFIG_AW_DRM_EINK200 is not set
CONFIG_AW_DRM_PANEL=y
CONFIG_PANEL_DSI_GENERAL=y
CONFIG_PANEL_LVDS_GENERAL=y
CONFIG_PANEL_RGB_GENERAL=y
CONFIG_PANEL_EDP_GENERAL=y
CONFIG_AW_DRM_PHY=y
CONFIG_SUNXI_SDMMC=y
CONFIG_SUNXI_USB=y
CONFIG_SUNXI_EFEX=y
CONFIG_SUNXI_BURN=y
CONFIG_SUNXI_CE_30=y
CONFIG_SUNXI_RSA_SOFTWARE=y
CONFIG_SUNXI_PHY_KEY=y
CONFIG_SUNXI_LRADC_KEY=y
CONFIG_SUNXI_ARISC_EXIST=y
CONFIG_ARISC_DEASSERT_BEFORE_KERNEL=y
CONFIG_XTENSA_DSP=y
CONFIG_BOOT_RISCV=y
CONFIG_SHA256=y
CONFIG_LZMA=y
CONFIG_SUNXI_ANDROID_OVERLAY=y
CONFIG_SUNXI_SPRITE=y
CONFIG_SECURE_STORAGE_KEY_HUK=y
CONFIG_SUNXI_SPRITE_CARTOON=y
CONFIG_SUNXI_UPDATE_GPT=y
CONFIG_SUNXI_BOOT_PARAM=y
```
